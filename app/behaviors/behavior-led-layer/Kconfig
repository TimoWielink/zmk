## app/behaviors/behavior-led-layer/Kconfig
```kconfig
config ZMK_BEHAVIOR_LED_LAYER
    bool "Layer LED indicator behavior"
    default y
    depends on DT_HAS_ZMK_BEHAVIOR_LED_LAYER_ENABLED
    help
        Enables GPIO-based LED indicators for active layers 
```

## app/dts/bindings/behaviors/zmk,behavior-led-layer.yaml
```yaml
description: Layer LED indicator behavior

compatible: "zmk,behavior-led-layer"

include: base.yaml 
```
